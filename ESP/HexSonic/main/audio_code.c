#include "audio_code.h"
#include "freertos/FreeRTOS.h"
#include "freertos/task.h"
#include "esp_log.h"
#include "driver/i2c_master.h"
#include "driver/gpio.h"
#include <string.h>

static const char *TAG = "AudioCode";

// 全局 I2C 设备句柄
static i2c_master_dev_handle_t s_audio_dev_handle = NULL;

#define Audio_I2C_TIMEOUT_MS 100
#define Audio_ADDR           (0x18 >> 1) // 芯片 I2C 地址

// ==========================================
// 1. 底层 I2C 读写封装 (新版 API)
// ==========================================
static esp_err_t audio_write_reg(uint8_t reg_addr, uint8_t data) {
    if (s_audio_dev_handle == NULL) return ESP_ERR_INVALID_STATE;
    uint8_t buf[2] = {reg_addr, data};
    return i2c_master_transmit(s_audio_dev_handle, buf, 2, Audio_I2C_TIMEOUT_MS);
}

// ==========================================
// 2. 寄存器配置表 (源自“能出声”的版本)
// ==========================================
struct REG_TAB {
    uint8_t Address;
    uint8_t Data;
};

// 初始化脚本
const struct REG_TAB m_reg_tab_initialization[] = {
    {0x00, 0x00}, {0x04, 0x00}, {0xfc, 0x86}, {0xfd, 0x22}, {0xfe, 0x25},
    {0x00, 0x00}, {0x00, 0x00}, {0x00, 0x00}, {0x00, 0x00}, {0x00, 0x00}
};

// DSP/Mixer/EQ 核心脚本
const struct REG_TAB m_reg_tab[] =
    {
        // Digital Off during DSP configuration
        {0x00, 0x00},
        {0x04, 0x00},
        {0x00, 0x00},
        {0x00, 0x00},
        {0x00, 0x00},
        {0x00, 0x00},
        {0x00, 0x00},
        // input mixer
        {0x00, 0x05},
        {0xb0, 0x08},
        {0xb1, 0x00},
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        {0xbf, 0x00},
        // EQ
        // EQ1 - left; Setting: Type - Low Shelf; Fc - 120; Gain - 2.0; Q - 0.707; Bandwidth - 239
        {0x00, 0x04},
        {0x18, 0x08},
        {0x19, 0x02},
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        {0x2b, 0xc6},
        // EQ2 - left; Setting: Type - All Pass; Fc - 800; Gain - -1.0; Q - 0.707; Bandwidth - 1000
        {0x2c, 0x08},
        {0x2d, 0x00},
        {0x2e, 0x00},
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        {0x3f, 0x00},
        // EQ3 - left; Setting: Type - Peaking; Fc - 230; Gain - -1.2; Q - 2.3; Bandwidth - 459
        {0x40, 0x07},
        {0x41, 0xfe},
        {0x42, 0x07},
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        {0x53, 0xe8},
        // EQ4 - left; Setting: Type - High Shelf; Fc - 13000; Gain - 4.3; Q - 0.707; Bandwidth - 1000
        {0x54, 0x0a},
        {0x55, 0x0d},
        {0x56, 0xee},
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        {0x67, 0x37},
        // EQ5 - left; Setting: Type - Peaking; Fc - 110; Gain - 0.0; Q - 3.0; Bandwidth - 219
        {0x68, 0x08},
        {0x69, 0x00},
        {0x6a, 0x00},
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        {0x7b, 0x61},
        // EQ6 - left; Setting: Type - All Pass; Fc - 28; Gain - 0.0; Q - 0.707; Bandwidth - 55
        {0x7c, 0x08},
        {0x7d, 0x00},
        {0x7e, 0x00},
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        {0x8f, 0x00},
        // EQ7 - left; Setting: Type - Peaking; Fc - 5000; Gain - 0.8; Q - 0.707; Bandwidth - 1000
        {0x90, 0x08},
        {0x91, 0x3e},
        {0x92, 0x84},
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        {0xa3, 0x66},
        // EQ8 - left; Setting: Type - High Shelf; Fc - 1200; Gain - -2.0; Q - 0.707; Bandwidth - 1000
        {0xa4, 0x06},
        {0xa5, 0x6f},
        {0xa6, 0xa8},
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        {0xb7, 0x35},
        // EQ9 - left; Setting: Type - Peaking; Fc - 8600; Gain - 1.0; Q - 1.707; Bandwidth - 1000
        {0xb8, 0x08},
        {0xb9, 0x3d},
        {0xba, 0xf7},
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        {0xcb, 0xb5},
        // EQ10 - left; Setting: Type - All Pass; Fc - 1000; Gain - 0.0; Q - 0.707; Bandwidth - 1000
        {0xcc, 0x08},
        {0xcd, 0x00},
        {0xce, 0x00},
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        {0xdf, 0x00},
        // EQ1 - right; Setting: Type - Low Shelf; Fc - 120; Gain - 2.0; Q - 0.707; Bandwidth - 239
        {0xe0, 0x08},
        {0xe1, 0x02},
        {0xe2, 0x9f},
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        {0xf3, 0xc6},
        // EQ2 - right; Setting: Type - All Pass; Fc - 800; Gain - -1.0; Q - 0.707; Bandwidth - 1000
        {0xf4, 0x08},
        {0xf5, 0x00},
        {0xf6, 0x00},
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        {0x0b, 0x00},
        // EQ3 - right; Setting: Type - Peaking; Fc - 230; Gain - -1.2; Q - 2.3; Bandwidth - 459
        {0x0c, 0x07},
        {0x0d, 0xfe},
        {0x0e, 0x07},
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        {0x1f, 0xe8},
        // EQ4 - right; Setting: Type - High Shelf; Fc - 13000; Gain - 4.3; Q - 0.707; Bandwidth - 1000
        {0x20, 0x0a},
        {0x21, 0x0d},
        {0x22, 0xee},
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        {0x33, 0x37},
        // EQ5 - right; Setting: Type - Peaking; Fc - 110; Gain - 0.0; Q - 3.0; Bandwidth - 219
        {0x34, 0x08},
        {0x35, 0x00},
        {0x36, 0x00},
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        {0x47, 0x61},
        // EQ6 - right; Setting: Type - All Pass; Fc - 28; Gain - 0.0; Q - 0.707; Bandwidth - 55
        {0x48, 0x08},
        {0x49, 0x00},
        {0x4a, 0x00},
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        {0x5b, 0x00},
        // EQ7 - right; Setting: Type - Peaking; Fc - 5000; Gain - 0.8; Q - 0.707; Bandwidth - 1000
        {0x5c, 0x08},
        {0x5d, 0x3e},
        {0x5e, 0x84},
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        {0x6f, 0x66},
        // EQ8 - right; Setting: Type - High Shelf; Fc - 1200; Gain - -2.0; Q - 0.707; Bandwidth - 1000
        {0x70, 0x06},
        {0x71, 0x6f},
        {0x72, 0xa8},
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        {0x83, 0x35},
        // EQ9 - right; Setting: Type - Peaking; Fc - 8600; Gain - 1.0; Q - 1.707; Bandwidth - 1000
        {0x84, 0x08},
        {0x85, 0x3d},
        {0x86, 0xf7},
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        {0x97, 0xb5},
        // EQ10 - right; Setting: Type - All Pass; Fc - 1000; Gain - 0.0; Q - 0.707; Bandwidth - 1000
        {0x98, 0x08},
        {0x99, 0x00},
        {0x9a, 0x00},
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        {0xab, 0x00},
        // Pre volume
        {0xc0, 0x03},
        {0xc1, 0x2f},
        {0xc2, 0x52},
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        {0xcb, 0x6b},
        // DRB
        {0x00, 0x06},
        {0x38, 0x08},
        {0x39, 0x00},
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        {0xe7, 0x95},
        // AGL
        {0x00, 0x04},
        {0x04, 0x01},
        {0x05, 0x80},
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        {0x17, 0x5a},
        // ClassD Control Registers
        {0x00, 0x00},
        {0x04, 0x00},
        {0x00, 0x01},
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        {0x04, 0x03},

};

// 音量映射表
const int my_acm8615VolTable[] = {
    0x032f52d0, 0x02d6a867, 0x0287a26c, 0x0241346f, 0x02026f31, 0x01ca7d76, 0x0198a135,
    0x016c310e, 0x0144960c, 0x012149a6, 0x0101d3f3, 0x00f367bf, 0x00e5ca15, 0x00d8ef67,
    0x00cccccd, 0x00c157fb, 0x00b68738, 0x00ac5156, 0x00a2adad, 0x0099940e, 0x0090fcbf,
    0x00813856, 0x00732ae2, 0x0066a4a5, 0x005b7b16, 0x00518848, 0x0048aa71, 0x0040c371,
    0x0039b872, 0x00337185, 0x002dd959, 0x0028dcec, 0x00246b4e, 0x00207568, 0x001cedc4,
    0x0019c865, 0x0016fa9c, 0x00147ae1, 0x001240b9, 0x00104491, 0x000e7fad, 0x000cec09,
    0x000b844a, 0x000a43aa, 0x000925e9, 0x0008273a, 0x0007443e, 0x000679f2, 0x000495bc, 0x00020c4a
};

// ==========================================
// 3. 核心控制功能
// ==========================================

void set_mute_audio_code(char status) {
    audio_write_reg(0x00, 0x00);
    if (status) {
        audio_write_reg(0x04, 0x0e); // Mute
        ESP_LOGI(TAG, "Audio Muted");
    } else {
        audio_write_reg(0x04, 0x03); // Unmute
        ESP_LOGI(TAG, "Audio Unmuted");
    }
}

void set_volume_audio_code(int vol, char delay) {
    if (vol > 100) vol = 100;
    
    unsigned int tmp = 0;
    int index = vol / 2;
    
    // 计算音量值
    if (vol % 2 == 0) {
        if (index > 0) index -= 1;
        tmp = my_acm8615VolTable[49 - index];
    } else {
        int index1 = (index + 1 >= 49) ? 49 : index + 1;
        tmp = (my_acm8615VolTable[49 - index] + my_acm8615VolTable[49 - index1]) / 2;
    }

    uint8_t v[4];
    v[0] = (tmp >> 24) & 0xff;
    v[1] = (tmp >> 16) & 0xff;
    v[2] = (tmp >> 8) & 0xff;
    v[3] = (tmp) & 0xff;

    // 写入 Page 5 的音量寄存器 (0xc0-0xc7)
    audio_write_reg(0x00, 0x05);
    audio_write_reg(0xc0, v[0]); audio_write_reg(0xc1, v[1]);
    audio_write_reg(0xc2, v[2]); audio_write_reg(0xc3, v[3]);
    audio_write_reg(0xc4, v[0]); audio_write_reg(0xc5, v[1]);
    audio_write_reg(0xc6, v[2]); audio_write_reg(0xc7, v[3]);

    if (delay) vTaskDelay(pdMS_TO_TICKS(10));
}

// ==========================================
// 4. 初始化入口
// ==========================================
char init_audio_code(void *i2c_dev_handle, unsigned char vol) {
    s_audio_dev_handle = (i2c_master_dev_handle_t)i2c_dev_handle;

    ESP_LOGI(TAG, "Starting ACM86xx Init...");

    // 1. 发送初始化脚本
    for (int i = 0; i < sizeof(m_reg_tab_initialization)/sizeof(struct REG_TAB); i++) {
        audio_write_reg(m_reg_tab_initialization[i].Address, m_reg_tab_initialization[i].Data);
    }
    
    vTaskDelay(pdMS_TO_TICKS(30)); // DSP 等待时间

    // 2. 发送主配置脚本
    for (int i = 0; i < sizeof(m_reg_tab)/sizeof(struct REG_TAB); i++) {
        audio_write_reg(m_reg_tab[i].Address, m_reg_tab[i].Data);
    }

    // 3. 设置初始音量并开音
    set_volume_audio_code(vol, 1);
    set_mute_audio_code(0);

    audio_write_reg( 0x00, 0x00);
    audio_write_reg( 0x04, 0x03);    

    ESP_LOGI(TAG, "ACM86xx Init Finished.");
    return 0;
}